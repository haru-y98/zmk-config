## boards/shields/jisplit89/Kconfig.shield
```kconfig
# Copyright (c) 2024
# SPDX-License-Identifier: MIT

config SHIELD_JISPLIT89_LEFT
    def_bool $(shields_list_contains,jisplit89_left)

config SHIELD_JISPLIT89_RIGHT
    def_bool $(shields_list_contains,jisplit89_right)
```

## config/boards/shields/ergoarrows/Kconfig.defconfig
```kconfig
if SHIELD_ERGOARROWS_LEFT || SHIELD_ERGOARROWS_RIGHT

config ZMK_KEYBOARD_NAME
    default "ErgoArrows"

config ZMK_SPLIT
    default y

if SHIELD_ERGOARROWS_LEFT

config ZMK_SPLIT_ROLE_CENTRAL
    default y

endif # SHIELD_ERGOARROWS_LEFT

endif # SHIELD_ERGOARROWS_LEFT || SHIELD_ERGOARROWS_RIGHT
```

## config/boards/shields/ergoarrows/Kconfig.shield
```kconfig
config SHIELD_ERGOARROWS_LEFT
    def_bool $(shields_list_contains,ergoarrows_left)

config SHIELD_ERGOARROWS_RIGHT
    def_bool $(shields_list_contains,ergoarrows_right)
```

## config/boards/shields/helix_pico/Kconfig.defconfig
```kconfig
if SHIELD_HELIX_PICO_LEFT

config ZMK_KEYBOARD_NAME
    default "Helix Pico"

config ZMK_SPLIT_ROLE_CENTRAL
    default y

endif # SHIELD_HELIX_PICO_LEFT

if SHIELD_HELIX_PICO_LEFT || SHIELD_HELIX_PICO_RIGHT

config ZMK_SPLIT
    default y

endif # SHIELD_HELIX_PICO_LEFT || SHIELD_HELIX_PICO_RIGHT
```

## config/boards/shields/helix_pico/Kconfig.shield
```kconfig
# Copyright (c) 2024 HaruStudio
# SPDX-License-Identifier: MIT

config SHIELD_HELIX_PICO_LEFT
    def_bool $(shields_list_contains,helix_pico_left)

config SHIELD_HELIX_PICO_RIGHT
    def_bool $(shields_list_contains,helix_pico_right)
```

## config/boards/shields/jisplit89/Kconfig.defconfig
```kconfig
if SHIELD_JISPLIT89_LEFT

config ZMK_KEYBOARD_NAME
    default "Jisplit89"

config ZMK_SPLIT_ROLE_CENTRAL
    default y

endif

if SHIELD_JISPLIT89_LEFT || SHIELD_JISPLIT89_RIGHT

config ZMK_SPLIT
    default y

if ZMK_RGB_UNDERGLOW

config WS2812_STRIP
    default y

config SPI
    default y

endif # ZMK_RGB_UNDERGLOW

endif
```

## config/boards/shields/jisplit89/Kconfig.shield
```kconfig
config SHIELD_JISPLIT89_LEFT
    def_bool $(shield_list_contains,jisplit89_left)
    select SPLIT_KEYBOARD

config SHIELD_JISPLIT89_RIGHT
    def_bool $(shield_list_contains,jisplit89_right)
    select SPLIT_KEYBOARD
```

## config/boards/shields/lily58/Kconfig.defconfig
```kconfig
if SHIELD_LILY58_LEFT

config ZMK_KEYBOARD_NAME
    default "TEST123456789"

config ZMK_SPLIT_ROLE_CENTRAL
    default y

endif

if SHIELD_LILY58_LEFT || SHIELD_LILY58_RIGHT

config ZMK_SPLIT
    default y

endif
```

## config/boards/shields/settings_reset/Kconfig.defconfig
```kconfig
if SHIELD_SETTINGS_RESET

config ZMK_KEYBOARD_NAME
    default "Settings Reset"

config ZMK_SETTINGS_RESET_ON_START
    default y

endif
```

## config/boards/shields/settings_reset/Kconfig.shield
```kconfig
config SHIELD_SETTINGS_RESET
    def_bool $(shield_list_contains,settings_reset)
```

## config/west.yml
```yaml
manifest:
  projects:
    - name: zmk
      url: https://github.com/zmkfirmware/zmk
      revision: v0.2.1  # ← 明示的な安定タグに変更！
      path: zmk
      import: true

  self:
    path: config
```
